## skills/cluster-3/22/code/Kconfig.projbuild
```kconfig
menu "Example Configuration"

    config ESP_WIFI_SSID
        string "Group_8"
        default "Group_8"
        help
            SSID (network name) for the example to connect to.

    config ESP_WIFI_PASSWORD
        string "Gamergod786."
        default "Gamergod786."
        help
            WiFi password (WPA or WPA2) for the example to use.

    config ESP_MAXIMUM_RETRY
        int "Maximum retry"
        default 5
        help
            Set the Maximum retry to avoid station reconnecting to the AP unlimited when the AP is really inexistent.
endmenu
```
